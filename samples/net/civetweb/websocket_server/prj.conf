## CMakeLists.txt
```
# Copyright (c) 2020 Alexander Kozhinov <AlexanderKozhinov@yandex.com>
#
# SPDX-License-Identifier: Apache-2.0

cmake_minimum_required(VERSION 3.20.0)

set(common_dir ${CMAKE_CURRENT_SOURCE_DIR}/../common)
set(common_src_dir ${common_dir}/src)
set(common_include_dir ${common_dir}/include)

set(inc_dir ${CMAKE_CURRENT_SOURCE_DIR}/include)
set(src_dir ${CMAKE_CURRENT_SOURCE_DIR}/src)

include_directories(
	${inc_dir}
	${common_include_dir}
)

option(CIVETWEB_ENABLE_WEBSOCKETS "Enable websockets connections" ON)

find_package(Zephyr REQUIRED HINTS $ENV{ZEPHYR_BASE})
project(civetweb_websocket_server)

target_sources(app PRIVATE
		${src_dir}/main.c
		${common_src_dir}/libc_extensions.c
		${src_dir}/http_server_handlers.c
		${src_dir}/websocket_server_handlers.c)

set(gen_dir ${ZEPHYR_BINARY_DIR}/include/generated/)
set(web_page_dir web_page)

file(MAKE_DIRECTORY ${gen_dir}/${web_page_dir})

# List of files that are used to generate .h file that can be included
# into .c file.
foreach(inc_file
	${web_page_dir}/index.html
	${web_page_dir}/index.css
	${web_page_dir}/jquery1.js
	${web_page_dir}/ws.js)

	# Generate normal and gzipped versions of each file:
	generate_inc_file_for_target(app
		${inc_file}
		${gen_dir}/${inc_file}.inc)

	generate_inc_file_for_target(app
		${inc_file}
		${gen_dir}/${inc_file}.gz.inc
		--gzip)

endforeach()

include(${ZEPHYR_BASE}/samples/net/common/common.cmake)
```

## prj.conf
```kconfig
# General config
CONFIG_CIVETWEB=y

# pthreads
CONFIG_POSIX_API=y
CONFIG_PTHREAD_IPC=y
CONFIG_POSIX_MQUEUE=y

# networking
CONFIG_NETWORKING=y
CONFIG_NET_IPV4=y
# CONFIG_NET_IPV6 is not set
CONFIG_NET_TCP=y
CONFIG_NET_SOCKETS=y

CONFIG_DNS_RESOLVER=y

CONFIG_NET_CONFIG_SETTINGS=y
CONFIG_NET_CONFIG_MY_IPV4_ADDR="192.0.2.1"
CONFIG_NET_CONFIG_MY_IPV4_NETMASK="255.255.255.0"
# CONFIG_NET_CONFIG_MY_IPV4_GW="192.0.2.2"
# CONFIG_NET_CONFIG_PEER_IPV4_ADDR="192.0.2.2"

# memory settings:
CONFIG_MINIMAL_LIBC_MALLOC_ARENA_SIZE=16384
CONFIG_NET_TX_STACK_SIZE=2048
CONFIG_NET_RX_STACK_SIZE=2048

CONFIG_ISR_STACK_SIZE=2048
CONFIG_MAIN_STACK_SIZE=2048
CONFIG_IDLE_STACK_SIZE=1024

# logging:
CONFIG_LOG=y
# CONFIG_NET_LOG=y
# CONFIG_LOG_STRDUP_MAX_STRING=256

# Do not include mbedtls via this option as civetweb does not
# work properly with mbedtls.
CONFIG_NET_TCP_ISN_RFC6528=n



#####


CONFIG_DEBUG=y

CONFIG_DNS_RESOLVER=n

CONFIG_NET_HOSTNAME_ENABLE=y
CONFIG_ETH_STM32_HAL=n

# Random number generator, required for tcp
CONFIG_TEST_RANDOM_GENERATOR=y

# logging:
CONFIG_LOG=y
CONFIG_LOG_BACKEND_RTT=y
CONFIG_USE_SEGGER_RTT=y
CONFIG_RTT_CONSOLE=y
CONFIG_CBPRINTF_FP_SUPPORT=y
CONFIG_LOG_BACKEND_RTT_OUTPUT_BUFFER_SIZE=100
CONFIG_LOG_BUFFER_SIZE=4096


# memory settings:
CONFIG_MINIMAL_LIBC_MALLOC_ARENA_SIZE=16384
CONFIG_NET_TX_STACK_SIZE=2048
CONFIG_NET_RX_STACK_SIZE=2048
CONFIG_NET_MAX_CONN=25
CONFIG_NET_MAX_CONTEXTS=25
# CONFIG_NET_TCP_MAX_RECV_WINDOW_SIZE=1024
# CONFIG_NET_BUF_DATA_SIZE=512
# CONFIG_NET_PKT_RX_COUNT=25
# CONFIG_NET_BUF_RX_COUNT=72
# CONFIG_NET_PKT_TX_COUNT=25
# CONFIG_NET_BUF_TX_COUNT=72


# USB Device settings
CONFIG_USB_DEVICE_STACK=y
CONFIG_USB_COMPOSITE_DEVICE=n
# Select USB Configurations
CONFIG_USB_DEVICE_NETWORK_ECM=n
CONFIG_USB_DEVICE_NETWORK_RNDIS=y
CONFIG_USB_MAX_POWER=250

# usb logging
CONFIG_USB_DRIVER_LOG_LEVEL_INF=y
```

## src/main.c
```c
/*
 * Copyright (c) 2020 Alexander Kozhinov <AlexanderKozhinov@yandex.com>
 *
 * SPDX-License-Identifier: Apache-2.0
 */

#include <zephyr/logging/log.h>
LOG_MODULE_REGISTER(main, LOG_LEVEL_DBG);

#include <zephyr/zephyr.h>
#include <zephyr/posix/pthread.h>
#include <zephyr/usb/usb_device.h>
#include <zephyr/net/net_config.h>

#include "civetweb.h"

#include "http_server_handlers.h"
#include "websocket_server_handlers.h"

#define HTTP_PORT	8080
#define HTTPS_PORT	4443

#define CIVETWEB_MAIN_THREAD_STACK_SIZE		CONFIG_MAIN_STACK_SIZE

/* Use smallest possible value of 1024 (see the line 18619 of civetweb.c) */
#define MAX_REQUEST_SIZE_BYTES			1024

K_THREAD_STACK_DEFINE(civetweb_stack, CIVETWEB_MAIN_THREAD_STACK_SIZE);

void *main_pthread(void *arg)
{
	static const char * const options[] = {
		"listening_ports", STRINGIFY(HTTP_PORT),
		"num_threads", "2",
		"max_request_size", STRINGIFY(MAX_REQUEST_SIZE_BYTES),
		NULL
	};

	struct mg_callbacks callbacks;
	struct mg_context *ctx;

	(void)arg;

	memset(&callbacks, 0, sizeof(callbacks));
	ctx = mg_start(&callbacks, NULL, (const char **)options);

	if (ctx == NULL) {
		LOG_ERR("Unable to start the server\n");
		return 0;
	}

	init_http_server_handlers(ctx);
	init_websocket_server_handlers(ctx);

	return 0;
}

void main(void)
{

#if defined(CONFIG_USB_DEVICE_STACK)
    int ret;
    ret = usb_enable(NULL);
    if (ret != 0) {
        printk("usb enable error %d\n", ret);
    }

    (void)net_config_init_app(NULL, "Initializing network");
#endif /* CONFIG_USB_DEVICE_STACK */

	pthread_attr_t civetweb_attr;
	pthread_t civetweb_thread;

	(void)pthread_attr_init(&civetweb_attr);
	(void)pthread_attr_setstack(&civetweb_attr, &civetweb_stack,
				    CIVETWEB_MAIN_THREAD_STACK_SIZE);

	(void)pthread_create(&civetweb_thread, &civetweb_attr,
				&main_pthread, 0);

	LOG_INF("WebSocket Server was started!");
}
```

## src/http_server_handlers.c
```c
/*
 * Copyright (c) 2020 Alexander Kozhinov <AlexanderKozhinov@yandex.com>
 *
 * SPDX-License-Identifier: Apache-2.0
 */

#include <zephyr/logging/log.h>
LOG_MODULE_REGISTER(http_server_handlers, LOG_LEVEL_DBG);

#include "http_server_handlers.h"

#define TX_CHUNK_SIZE_BYTES	CONFIG_NET_TX_STACK_SIZE

#define URL_MAIN		"/$"
#define URL_INDEX_CSS		"/index.css"
#define URL_INDEX_HTML		"/index.html"
#define URL_FAVICON_ICO		"/favicon.ico"
#define URL_WS_JS		"/ws.js"
#define URL_JQUERY1_JS  "/jquery1.js"
#define URL_JQUERY2_JS  "/jquery2.js"
#define URL_JQUERY3_JS  "/jquery3.js"
#define URL_JQUERY4_JS  "/jquery4.js"
#define URL_JQUERY5_JS  "/jquery5.js"
#define URL_JQUERY6_JS  "/jquery6.js"
#define URL_JQUERY7_JS  "/jquery7.js"

#define HTTP_TEXT_HTML		"text/html"
#define HTTP_TEXT_CSS		"text/css"
#define HTTP_TEXT_JS		"text/javascript"
#define HTTP_EOFL		"\r\n"  /* http end of line */

#define HTTP_CONTEND_ENCODING	"Content-Encoding: "
#define HTTP_ENCODING_GZ	"gzip"

#define __code_decl	/* static */
#define __data_decl	static

__code_decl void this_register_handlers(struct mg_context *ctx);

__code_decl int this_send_buffer_chunked(struct mg_connection *conn,
					 const char *mime_type,
					 const char *buff,
					 const size_t buff_len);

__code_decl int this_redirect_2_index_html(struct mg_connection *conn,
					   void *cbdata);
__code_decl int this_index_html_handler(struct mg_connection *conn,
					void *cbdata);
__code_decl int this_index_css_handler(struct mg_connection *conn,
					void *cbdata);
__code_decl int this_ws_js_handler(struct mg_connection *conn,
				   void *cbdata);
__code_decl int this_favicon_ico_handler(struct mg_connection *conn,
					 void *cbdata);

__code_decl int this_jquery1_js_handler(struct mg_connection *conn, void *cbdata);

__code_decl void this_set_return_value(int *ret_val);

void init_http_server_handlers(struct mg_context *ctx)
{
	this_register_handlers(ctx);
}

__code_decl void this_register_handlers(struct mg_context *ctx)
{
	mg_set_request_handler(ctx, URL_MAIN,
				this_redirect_2_index_html, NULL);
	mg_set_request_handler(ctx, URL_INDEX_HTML,
				this_index_html_handler, NULL);
	mg_set_request_handler(ctx, URL_INDEX_CSS,
				this_index_css_handler, NULL);
	mg_set_request_handler(ctx, URL_WS_JS,
				this_ws_js_handler, NULL);
	mg_set_request_handler(ctx, URL_FAVICON_ICO,
				this_favicon_ico_handler, NULL);


	mg_set_request_handler(ctx, URL_JQUERY1_JS, this_jquery1_js_handler, NULL);
	mg_set_request_handler(ctx, URL_JQUERY2_JS, this_jquery1_js_handler, NULL);
	mg_set_request_handler(ctx, URL_JQUERY3_JS, this_jquery1_js_handler, NULL);
	mg_set_request_handler(ctx, URL_JQUERY4_JS, this_jquery1_js_handler, NULL);
	mg_set_request_handler(ctx, URL_JQUERY5_JS, this_jquery1_js_handler, NULL);
	mg_set_request_handler(ctx, URL_JQUERY6_JS, this_jquery1_js_handler, NULL);
	mg_set_request_handler(ctx, URL_JQUERY7_JS, this_jquery1_js_handler, NULL);
}

__code_decl int this_send_buffer_chunked(struct mg_connection *conn,
					 const char *mime_type,
					 const char *buff,
					 const size_t buff_len)
{
	int ret = 0;

	ret = mg_send_http_ok(conn, mime_type, -1);
	if (ret < 0) {
		goto error_this_send_buffer_chunked;
	}

	long left_bytes = buff_len;
	char *itr = (char *)buff;  /* buffer iterator */

	LOG_DBG("Transferring:");
	LOG_DBG("itr: 0x%08X ret: %d left_bytes: %ld chunk_size: %zd B",
		(unsigned int)itr, ret, left_bytes, TX_CHUNK_SIZE_BYTES);

	while (left_bytes > TX_CHUNK_SIZE_BYTES) {
		ret = mg_send_chunk(conn, itr, TX_CHUNK_SIZE_BYTES);
		itr += TX_CHUNK_SIZE_BYTES;
		left_bytes -= TX_CHUNK_SIZE_BYTES;

		LOG_DBG("itr: 0x%08X ret: %d left_bytes: %ld",
			(unsigned int)itr, ret, left_bytes);

		if (ret < 0) {
			goto error_this_send_buffer_chunked;
		}
	}

	if (left_bytes > 0) {
		ret = mg_send_chunk(conn, itr, left_bytes);
		itr += left_bytes;
		left_bytes = 0;

		LOG_DBG("itr: 0x%08X ret: %d left_bytes: %ld",
			(unsigned int)itr, ret, left_bytes);

		if (ret < 0) {
			goto error_this_send_buffer_chunked;
		}
	}

	/* Must be sent at the end of the chunked sequence */
	ret = mg_send_chunk(conn, "", 0);

error_this_send_buffer_chunked:
	if (ret < 0) {
		LOG_ERR("aborted! ret: %d", ret);
	}

	return ret;
}

__code_decl int this_redirect_2_index_html(struct mg_connection *conn,
					   void *cbdata)
{
	int ret = 0;

	ret = mg_send_http_redirect(conn, URL_INDEX_HTML, 303);
	return 202;
}


__code_decl int this_jquery1_js_handler(struct mg_connection *conn, void *cbdata)
{

	__data_decl const char jquery[] = {
#include "web_page/jquery1.js.gz.inc"
	};

	int ret = 0;

	ret = this_send_buffer_chunked(conn, HTTP_TEXT_JS
					     HTTP_EOFL
					     HTTP_CONTEND_ENCODING
					     HTTP_ENCODING_GZ,
					     jquery, sizeof(jquery));
	this_set_return_value(&ret);
	return ret;
}

__code_decl int this_jquery2_js_handler(struct mg_connection *conn, void *cbdata)
{

	__data_decl const char jquery[] = {
#include "web_page/jquery1.js.gz.inc"
	};

	int ret = 0;

	ret = this_send_buffer_chunked(conn, HTTP_TEXT_JS
					     HTTP_EOFL
					     HTTP_CONTEND_ENCODING
					     HTTP_ENCODING_GZ,
					     jquery, sizeof(jquery));
	this_set_return_value(&ret);
	return ret;
}

__code_decl int this_index_html_handler(struct mg_connection *conn,
					void *cbdata)
{
	__data_decl const char index_html[] = {
#include "web_page/index.html.gz.inc"
	};

	int ret = 0;

	ret = this_send_buffer_chunked(conn, HTTP_TEXT_HTML
					     HTTP_EOFL
					     HTTP_CONTEND_ENCODING
					     HTTP_ENCODING_GZ,
					     index_html, sizeof(index_html));
	this_set_return_value(&ret);
	return ret;
}

__code_decl int this_index_css_handler(struct mg_connection *conn, void *cbdata)
{
	__data_decl const char index_css[] = {
#include "web_page/index.css.gz.inc"
	};

	int ret = 0;

	ret = this_send_buffer_chunked(conn, HTTP_TEXT_CSS
					     HTTP_EOFL
					     HTTP_CONTEND_ENCODING
					     HTTP_ENCODING_GZ,
					     index_css, sizeof(index_css));
	this_set_return_value(&ret);
	return ret;
}

__code_decl int this_ws_js_handler(struct mg_connection *conn, void *cbdata)
{
	__data_decl const char ws_js[] = {
#include "web_page/ws.js.gz.inc"
	};

	int ret = 0;

	ret = this_send_buffer_chunked(conn, HTTP_TEXT_JS
					     HTTP_EOFL
					     HTTP_CONTEND_ENCODING
					     HTTP_ENCODING_GZ,
					     ws_js, sizeof(ws_js));
	this_set_return_value(&ret);
	return ret;
}

__code_decl int this_favicon_ico_handler(struct mg_connection *conn,
					 void *cbdata)
{
	int ret = 404;
	return ret;  /* should fail */
}

__code_decl void this_set_return_value(int *ret_val)
{
	if (*ret_val < 0) {
		*ret_val = 404;  /* 404 - HTTP FAIL or 0 - handler fail */
	} else {
		*ret_val = 200;  /* 200 - HTTP OK*/
	}
}
```
